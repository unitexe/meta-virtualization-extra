## conf/distro/pokyless-graphics.conf
```bitbake
require conf/distro/poky.conf
require distroless.inc
require graphics.inc

DISTRO = "pokylessgraphics"
DISTRO_NAME = "Pokyless Graphics"
DISTRO_VERSION = "0.1-beta-${DATE}"
DISTRO_CODENAME = "main"
SDK_VENDOR = "-pokylessgraphicssdk"

MAINTAINER = "unitexe <unitexe70@gmail.com>"

TARGET_VENDOR = "-pokylessgraphics"
```

## conf/distro/pokylessui.conf
```bitbake
require conf/distro/poky.conf
require distroless.inc
require graphics.inc

DISTRO = "pokylessui"
DISTRO_NAME = "Pokyless UI"
DISTRO_VERSION = "0.1-beta-${DATE}"
DISTRO_CODENAME = "main"
SDK_VENDOR = "-pokylessuisdk"

MAINTAINER = "unitexe <unitexe70@gmail.com>"

TARGET_VENDOR = "-pokylessui"
```

## conf/distro/rocky.conf
```bitbake
require conf/distro/poky.conf
require distroless.inc

DISTRO = "rocky"
DISTRO_NAME = "Rocky"
DISTRO_VERSION = "0.1-beta-${DATE}"
DISTRO_CODENAME = "main"
SDK_VENDOR = "-rockysdk"

MAINTAINER = "unitexe <unitexe70@gmail.com>"

TARGET_VENDOR = "-rocky"

TCLIBC = "musl"
```

## conf/layer.conf
```bitbake
BBPATH .= ":${LAYERDIR}"

BBFILES += "\
    ${LAYERDIR}/recipes-*/*/*.bb \
    ${LAYERDIR}/recipes-*/*/*.bbappend \
"

BBFILE_COLLECTIONS += "meta-virtualization-extra"
BBFILE_PATTERN_meta-virtualization-extra = "^${LAYERDIR}/"
BBFILE_PRIORITY_meta-virtualization-extra = "9"

LAYERDEPENDS_meta-virtualization-extra += "core openembedded-layer virtualization-layer"

LAYERSERIES_COMPAT_meta-virtualization-extra = "scarthgap"
```
